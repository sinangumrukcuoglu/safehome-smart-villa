## firmware/sdkconfig.defaults
```kconfig
# WiFi CSI Configuration
CONFIG_ESP_WIFI_CSI_ENABLED=y
CONFIG_ESP_WIFI_MGMT_SBUF_NUM=32
CONFIG_ESP_WIFI_AMPDU_ENABLED=y

# FreeRTOS Tick Rate (1000Hz for precise timing)
CONFIG_FREERTOS_HZ=1000

# WiFi and Network Settings
CONFIG_ESP_WIFI_STA_AUTOCONNECT_ENABLED=y
CONFIG_ESP_WIFI_SOFTAP_SUPPORT=n
CONFIG_LWIP_TCPIP_CORE_LOCKING=1

# Memory and Performance
CONFIG_ESP_TASK_WDT_TIMEOUT_S=30
CONFIG_ESP_TASK_WDT_CHECK_IDLE_TASK_CPU0=n
```
